## Kconfig
```kconfig
# Copyright (c) 2024 Kacper Dalach
# SPDX-License-Identifier: Apache-2.0

config TOMLC99_LIBRARY
	bool "toml support"

module = TOMLC99
module-str = tomlc99
source "subsys/logging/Kconfig.template.log_config"
```

## tests/testcase.yaml
```yaml
tests:
  libraries.encoding.toml:
    tags: toml
    platform_allow:
      - native_posix
  libraries.encoding.toml.build:
    build_only: true
    tags: toml
    platform_allow:
      - native_posix
      - qemu_x86
      - qemu_cortex_a9
      - qemu_cortex_m3
      - qemu_cortex_r5
      - qemu_cortex_a53
      - qemu_kvm_arm64
      - qemu_riscv32e
      - qemu_riscv32
      - qemu_riscv64
      - qemu_malta
      - qemu_leon3
```
